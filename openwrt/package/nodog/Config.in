## openwrt/package/nodog/Config.in
```kconfig
# nodog config
config NODOG_DEBUG
   bool "Enable compilation of debugging features"
   depends on DEVEL && PACKAGE_nodog
   default n

config NODOG_UUID
   bool "Enable use of libuuid features"
   depends on DEVEL && PACKAGE_libuuid
   default y

#config NODOG_OPENSSL
#   bool "Enable use of openssl features"
#   depends on DEVEL && PACKAGE_libopenssl
#   default y

#config NODOG_ZLIB
#   bool "Enable use of zlib features"
#   depends on DEVEL && PACKAGE_zlib
#   default y
```
